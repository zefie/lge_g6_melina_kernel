/* Copyright (c) 2014, Code Aurora Forum. All rights reserved.
 *
 * This program is free software; you can redistribute it and/or modify
 * it under the terms of the GNU General Public License version 2 and
 * only version 2 as published by the Free Software Foundation.
 *
 * This program is distributed in the hope that it will be useful,
 * but WITHOUT ANY WARRANTY; without even the implied warranty of
 * MERCHANTABILITY or FITNESS FOR A PARTICULAR PURPOSE.  See the
 * GNU General Public License for more details.
 */

&mdss_mdp {
	dsi_sw49410_dsc_1440_3120_cmd: qcom,mdss_dsi_sw49410_dsc_1440_3120_cmd {
		qcom,mdss-dsi-panel-name = "SW49410 1440 3120 cmd mode dsc dsi panel";
		qcom,mdss-dsi-panel-type = "dsi_cmd_mode";
		qcom,mdss-dsi-panel-framerate = <60>;
		qcom,mdss-dsi-virtual-channel-id = <0>;
		qcom,mdss-dsi-stream = <0>;
		qcom,mdss-dsi-panel-width = <1440>;
		qcom,mdss-dsi-panel-height = <3120>;
		qcom,mdss-dsi-h-front-porch = <168>;
		qcom,mdss-dsi-h-back-porch = <84>;
		qcom,mdss-dsi-h-pulse-width = <4>;
		qcom,mdss-dsi-h-sync-skew = <0>;
		qcom,mdss-dsi-v-back-porch = <18>;
		qcom,mdss-dsi-v-front-porch = <2>;
		qcom,mdss-dsi-v-pulse-width = <18>;
		qcom,mdss-dsi-h-left-border = <0>;
		qcom,mdss-dsi-h-right-border = <0>;
		qcom,mdss-dsi-v-top-border = <0>;
		qcom,mdss-dsi-v-bottom-border = <0>;
		qcom,mdss-dsi-t-clk-post = <0x0D>;
		qcom,mdss-dsi-t-clk-pre = <0x2D>;
		qcom,mdss-dsi-bpp = <24>;
		qcom,mdss-dsi-color-order = "rgb_swap_rgb";
		qcom,mdss-dsi-underflow-color = <0xff>;
		qcom,mdss-dsi-border-color = <0>;
		qcom,mdss-dsi-h-sync-pulse = <0>;
		qcom,mdss-dsi-traffic-mode = "burst_mode";
		qcom,mdss-dsi-lane-map = "lane_map_0123";
		qcom,mdss-dsi-bllp-eof-power-mode;
		qcom,mdss-dsi-bllp-power-mode;
		qcom,partial-update-enabled;
		qcom,panel-roi-alignment = <1440 60 1440 60 1440 60>;
		qcom,mdss-dsi-lane-0-state;
		qcom,mdss-dsi-lane-1-state;
		qcom,mdss-dsi-lane-2-state;
		qcom,mdss-dsi-lane-3-state;
		qcom,mdss-dsi-hor-line-idle = <0 40 256>,
						<40 120 128>,
						<120 240 64>;
		qcom,mdss-dsi-panel-timings-phy-v2 = [
			23 1F 07 09 05 03 04 a0
			23 1F 07 09 05 03 04 a0
			23 1F 07 09 05 03 04 a0
			23 1F 07 09 05 03 04 a0
			23 19 07 08 05 03 04 a0
			];
		qcom,mdss-dsi-reset-sequence = <1 10>, <0 10>, <1 10>;
		qcom,mdss-dsi-bl-max-level = <4095>;
		qcom,mdss-dsi-dma-trigger = "trigger_sw";
		qcom,mdss-dsi-mdp-trigger = "none";
		qcom,mdss-dsi-te-pin-select = <1>;
		qcom,mdss-dsi-wr-mem-start = <0x2c>;
		qcom,mdss-dsi-wr-mem-continue = <0x3c>;
		qcom,mdss-dsi-te-dcs-command = <1>;
		qcom,mdss-dsi-te-check-enable;
		qcom,mdss-dsi-te-using-te-pin;

		qcom,ulps-enabled;
		qcom,suspend-ulps-enabled;
		qcom,mdss-dsi-lp11-init;
		qcom,mdss-dsi-tx-eot-append;
		qcom,mdss-mdp-transfer-time-us = <15200>;
		qcom,cont-splash-enabled;

		qcom,mdss-dsi-panel-hdr-enabled;
		qcom,mdss-dsi-panel-hdr-color-primaries = <14649 15851 33084 15473 13806 31961 7476 2719>;
		qcom,mdss-dsi-panel-peak-brightness = <5000000>;	/* max. 500nits */
		qcom,mdss-dsi-panel-blackness-level = <3022>;

		lge,ddic-name = "sw49410";
		lge,use-u2-fsc;
		lge,fsc-curr-ua-u3 = <20000>;
		lge,fsc-curr-ua-u2 = <2500>;

		lge,use-color-manager;
		lge,mdss-dsi-extra-command-names =
			"u2", "u3",	/* aod */
			"mplus-ctrl", "mplus-wr-start1", "mplus-wr-start2", "mplus-wr-start3",	/* mplus */
			"sharpness", "ie-ctrl", "dg-dummy","color-dummy",	/* advanced IE */
			"on-with-apo";	/* etc */

		lge,mdss-dsi-extra-command-u2 = [
			/* U2 Corner Down */
			39 01 00 00 00 00 03 BF 4F 00
			/* Partial Area */
			39 01 00 00 00 00 05 30 00 00 03 1F
			/* U2 Control */
			39 01 00 00 00 00 12 CD 09 86 C2 80 00 00 00 00 00 00 00 00 0C 12 00 00 00
			/* Partial Mode ON  + min 55ms*/
			05 01 00 00 37 00 01 12
		];
		lge,mdss-dsi-extra-command-u2-state = "dsi_lp_mode";
		lge,mdss-dsi-extra-command-u3 = [
			/*Black Frame Setting*/
			39 01 00 00 00 00 03 BD 01 05
			/* U2 Corner Down */
			39 01 00 00 00 00 03 BF 4F 02
			/* Normal Mode ON + min 40ms*/
			05 01 00 00 28 00 01 13
		];
		lge,mdss-dsi-extra-command-u3-state = "dsi_lp_mode";

		lge,mdss-dsi-extra-command-mplus-ctrl = [39 01 00 00 00 00 05 D3 12 01 00 00];
		lge,mdss-dsi-extra-command-mplus-ctrl-state = "dsi_hs_mode";
		lge,mdss-dsi-extra-command-mplus-wr-start1 = [39 01 00 00 00 00 96 D4 DC 5F 9C BE 39 39 39 47 48 48 48 3A 00 03 6D 80 00 00 8C 66 00 00 8C 66 00 00 8C 66 00 0A 48 80 00 0A 48 80 00 0A 48 80 00 0A 48 80 20 0A 14 0A 18 00 1C CC 23 9E 23 9E 01 01 01 01 04 04 04 04 01 00 02 80 00 10 00 10 00 10 13 9E 13 9E 13 9E 13 9E 05 05 05 05 05 05 05 05 23 9E FF FF 13 33 18 00 16 66 10 00 FF 01 00 02 00 03 00 04 00 05 00 06 00 07 00 08 00 09 00 0A 00 0B 00 0C 00 0D 00 0E 00 0F 00 1B 25 DC 18 00 20 00 1C E1 00 FF E0 C8 C8 41 8F];
		lge,mdss-dsi-extra-command-mplus-wr-start1-state = "dsi_hs_mode";
		lge,mdss-dsi-extra-command-mplus-wr-start2 = [39 01 00 00 00 00 96 D4 DC 5F 9C BE 39 39 39 47 48 48 48 3A 00 03 6D 80 00 00 8C 66 00 00 8C 66 00 00 8C 66 00 0A 48 80 00 0A 48 80 00 0A 48 80 00 0A 48 80 20 0A 14 0A 18 00 1C CC 23 9E 23 9E 01 01 01 01 04 04 04 04 01 00 02 80 00 10 00 10 00 10 13 9E 13 9E 13 9E 13 9E 05 05 05 05 05 05 05 05 23 9E FF FF 13 33 18 00 16 66 10 00 FF 01 00 02 00 03 00 04 00 05 00 06 00 07 00 08 00 09 00 0A 00 0B 00 0C 00 0D 00 0E 00 0F 00 1B 25 DC 18 00 20 00 1C E1 00 FF E0 C8 C8 41 8F];
		lge,mdss-dsi-extra-command-mplus-wr-start2-state = "dsi_hs_mode";
		lge,mdss-dsi-extra-command-mplus-wr-start3 = [39 01 00 00 00 00 96 D4 DC 5F 9C A6 39 39 39 47 48 48 48 3A 00 22 47 00 00 2F FD 00 00 22 47 00 00 0D B6 00 00 89 1C 00 00 2F FD 00 00 22 47 00 00 0D B6 00 20 00 00 00 18 00 23 9E 23 9E 23 9E 06 06 06 06 05 05 05 05 01 00 02 80 00 C8 01 80 00 30 13 9E 13 9E 13 9E 13 9E 10 10 10 10 10 10 10 10 23 9E FF FF 18 00 18 00 16 66 10 00 FF 01 00 02 00 03 00 04 00 05 00 06 00 07 00 08 00 09 00 0A 00 0B 00 0C 00 0D 00 0E 00 0F 00 1B 25 DC 18 00 20 00 1C E1 00 FF E0 C8 C8 41 8F];
		lge,mdss-dsi-extra-command-mplus-wr-start3-state = "dsi_hs_mode";
		lge,mdss-dsi-extra-command-sharpness = [39 01 00 00 00 00 06 F3 00 01 00 0D 00];
		lge,mdss-dsi-extra-command-sharpness-state = "dsi_hs_mode";
		lge,mdss-dsi-extra-command-ie-ctrl = [
			15 01 00 00 00 00 02 55 81
			39 01 00 00 00 00 0E FC 13 70 D0 26 30 7C 02 FF 12 22 22 10 00
		];
		lge,mdss-dsi-extra-command-ie-ctrl-state = "dsi_hs_mode";
		lge,mdss-dsi-extra-command-dg-dummy = [
			39 01 00 00 00 00 11 F6 40 40 40 40 40 40 40 40 00 00 00 00 00 00 00 00
			39 01 00 00 00 00 11 F7 40 40 40 40 40 40 40 40 00 00 00 00 00 00 00 00
			39 01 00 00 00 00 11 F8 40 40 40 40 40 40 40 40 00 00 00 00 00 00 00 00
			39 01 00 00 00 00 02 F5 00
		];
		lge,mdss-dsi-extra-command-dg-dummy-state = "dsi_hs_mode";

		lge,mdss-dsi-extra-command-color-dummy = [
			39 01 00 00 00 00 06 F3 00 01 00 0D 00
			39 01 00 00 00 00 0E F4 00 00 40 83 C5 00 01 00 00 00 00 00 00
		];
		lge,mdss-dsi-extra-command-color-dummy-state = "dsi_hs_mode";

		lge,mdss-dsi-extra-command-on-with-apo = [
			/* TE On */
			15 01 00 00 00 00 02 35 00
			/* Page Address Set */
			39 01 00 00 00 00 05 2B 00 00 0C 2F
			/* BLU Control */
			15 01 00 00 00 00 02 51 FF
			15 01 00 00 00 00 02 53 2C
			15 01 00 00 00 00 02 5E 00
			15 01 00 00 00 00 02 55 81
			/*Manufacturer protection*/
			15 01 00 00 00 00 02 B0 AC
			/*Source Control*/
			39 01 00 00 00 00 09 B3 04 04 28 08 5A 12 23 02
			/*Gate & Mux Control*/
			39 01 00 00 00 00 20 B4 11 04 02 02 02 02 02 01 01 01 01 01 01 D0 E4 E4 E4 93 4E 39 0A 10 18 25 24 00 00 00 00 00 00
			/*Sync Setup*/
			39 01 00 00 00 00 09 B5 2E 0F 10 C0 00 10 C0 00
			/*Panel Setting*/
			39 01 00 00 00 00 06 B6 03 05 0B B3 30
			/*Touch Timing Control*/
			39 01 00 00 00 00 20 B8 57 02 90 40 5D D0 05 00 00 18 22 04 01 02 90 40 4C C0 04 00 00 18 22 04 01 08 00 3A 86 83 00
			/*Touch Source Setting*/
			39 01 00 00 00 00 06 B9 64 64 2A 3F EE
			/*DSC Configuration*/
			39 01 00 00 00 00 0C BA 3D 1F 01 FF 01 3C 1F 01 FF 01 00
			/*Low Rate Refresh Setting*/
			39 01 00 00 00 00 05 BC 00 00 00 10
			/*Black Frame Setting*/
			39 01 00 00 00 00 03 BD 00 00
			/* U2 Corner Down */
			39 01 00 00 00 00 03 BF 4F 02
			/*Internal Oscillator Setting*/
			39 01 00 00 00 00 0B C0 00 04 18 07 11 11 3C 00 0A 0A
			/*Power Control1*/
			39 01 00 00 00 00 07 C1 01 00 F0 C2 CF 0C
			/*Power Control2*/
			39 01 00 00 00 00 09 C2 CC 44 44 20 22 26 21 00
			/*Power Control3*/
			39 01 00 00 00 00 13 C3 92 11 09 09 11 CC 02 02 A4 A4 02 A2 38 28 14 40 38 C0
			/*Vcom Setting*/
			39 01 00 00 00 00 03 C4 26 00
			/*Power Sequence Option Configuration - source & vcom GND*/
			39 01 00 00 00 00 06 C9 01 54 03 04 00
			/*Abrupt Power Off Control*/
			39 01 00 00 00 00 03 CA 9B 10
			/*LFD Control*/
			39 01 00 00 00 00 06 CB F3 90 3D 30 CC
			/*Tail TFT Setting*/
			39 01 00 00 00 00 06 CC 00 40 50 90 41
			/*U2 Option*/
			39 01 00 00 00 00 03 CE 00 00
			/*Gamma*/
			39 01 00 00 00 00 A9 D0 12 05 20 1B 2C 28 3F 3F 50 50 68 68 71 71 79 79 82 82 8A 8A 99 99 3F 3F 9F 9F 91 91 89 89 81 81 76 76 64 64 46 46 2d 2d 00 01 12 05 20 1B 2C 28 3F 3F 50 50 68 68 71 71 79 79 82 82 8A 8A 99 99 3F 3F 9F 9F 91 91 89 89 81 81 76 76 64 64 46 46 2d 2d 00 01 12 05 20 1B 2C 28 3F 3F 50 50 68 68 71 71 79 79 82 82 8A 8A 99 99 3F 3F 9F 9F 91 91 89 89 81 81 76 76 64 64 46 46 2d 2d 00 01 12 05 20 1B 2C 28 3F 3F 50 50 68 68 71 71 79 79 82 82 8A 8A 99 99 3F 3F 9F 9F 91 91 89 89 81 81 76 76 64 64 46 46 2d 2d 00 01
			39 01 00 00 00 00 A9 D1 12 05 20 1B 2C 28 3F 3D 4F 4F 66 66 6E 6E 76 76 80 80 88 88 95 95 3F 3F A2 A2 94 94 8B 8B 81 81 75 75 66 66 47 47 2D 2D 00 01 12 05 20 1B 2C 28 3F 3D 4f 4f 66 66 6e 6e 76 76 80 80 88 88 95 95 3F 3F A2 A2 94 94 8b 8b 81 81 75 75 66 66 47 47 2d 2d 00 01 12 05 20 1B 2C 28 3F 3D 4f 4f 66 66 6e 6e 76 76 80 80 88 88 95 95 3F 3F A2 A2 94 94 8b 8b 81 81 75 75 66 66 47 47 2d 2d 00 01 12 05 20 1B 2C 28 3F 3D 4f 4f 66 66 6e 6e 76 76 80 80 88 88 94 94 3F 3F A4 A4 95 95 8b 8b 81 81 75 75 66 66 47 47 2d 2d 00 01
			39 01 00 00 00 00 A9 D2 12 05 20 1B 2C 28 3F 3D 4F 4F 66 66 6E 6E 76 76 80 80 88 88 95 95 3F 3F A2 A2 94 94 8B 8B 81 81 75 75 66 66 47 47 2D 2D 00 01 12 05 20 1B 2C 28 3F 3D 4f 4f 66 66 6e 6e 76 76 80 80 88 88 95 95 3F 3F A2 A2 94 94 8b 8b 81 81 75 75 66 66 47 47 2d 2d 00 01 12 05 20 1B 2C 28 3F 3D 4f 4f 66 66 6e 6e 76 76 80 80 88 88 95 95 3F 3F A2 A2 94 94 8b 8b 81 81 75 75 66 66 47 47 2d 2d 00 01 12 05 20 1B 2C 28 3F 3D 4f 4f 66 66 6e 6e 76 76 80 80 88 88 94 94 3F 3F A4 A4 95 95 8b 8b 81 81 75 75 66 66 47 47 2d 2d 00 01
			/* MPLUS Control */
			39 01 00 00 00 00 05 D3 12 01 00 00
			/*Mplus Setting*/
			39 01 00 00 00 00 96 D4 DC 5F 9C BE 39 39 39 47 48 48 48 3A 00 03 6D 80 00 00 8C 66 00 00 8C 66 00 00 8C 66 00 0A 48 80 00 0A 48 80 00 0A 48 80 00 0A 48 80 20 0A 14 0A 18 00 1C CC 23 9E 23 9E 01 01 01 01 04 04 04 04 01 00 02 80 00 10 00 10 00 10 13 9E 13 9E 13 9E 13 9E 05 05 05 05 05 05 05 05 23 9E FF FF 13 33 18 00 16 66 10 00 FF 01 00 02 00 03 00 04 00 05 00 06 00 07 00 08 00 09 00 0A 00 0B 00 0C 00 0D 00 0E 00 0F 00 1B 25 DC 18 00 20 00 1C E1 00 FF E0 C8 C8 41 8F
			/*Notch Up Gradation*/
			39 01 00 00 00 00 21 AD 01 02 03 04 05 06 06 06 06 06 06 06 06 06 06 06 20 40 60 90 C0 F0 FF FF FF FF FF FF FF FF FF FF
			/*Notch Down Gradation*/
			39 01 00 00 00 00 21 AE 01 02 03 04 05 06 06 06 06 06 06 06 06 06 06 06 20 40 60 90 C0 F0 FF FF FF FF FF FF FF FF FF FF
			/*GIP Setting*/
			39 01 00 00 00 00 1B E5 0B 0A 0C 00 02 04 06 08 0F 1B 02 1A 1A 0B 0A 0C 01 03 05 07 09 10 1B 03 1A 1A
			/*Mux Setting*/
			39 01 00 00 00 00 11 E6 11 12 13 14 15 16 17 18 11 12 13 14 15 16 17 18
			/*Test1*/
			39 01 00 00 00 00 07 ED 21 49 00 00 00 00
			/*BLU Control*/
			15 01 00 00 00 00 02 55 81
			/*Sharpness*/
			39 01 00 00 00 00 06 F3 00 01 00 0D 00
			39 01 00 00 00 00 0E F4 00 00 40 83 C5 00 01 00 00 00 00 00 00
			39 01 00 00 00 00 18 FB 20 40 60 80 A0 C0 E0 1A 29 2C 2C 2B 20 22 00 9A A9 B9 C8 D8 E7 F4 FF
			/*Gamma Correction*/
			39 01 00 00 00 00 02 F5 00
			39 01 00 00 00 00 11 F6 40 40 40 40 40 40 40 40 00 00 00 00 00 00 00 00
			39 01 00 00 00 00 11 F7 40 40 40 40 40 40 40 40 00 00 00 00 00 00 00 00
			39 01 00 00 00 00 11 F8 40 40 40 40 40 40 40 40 00 00 00 00 00 00 00 00
			/*BLU PWM Control*/
			39 01 00 00 00 00 0E FC 13 70 D0 26 30 7C 02 FF 12 22 22 10 00
			/* Normal Display mode on */
			05 01 00 00 00 00 01 13
			/* Sleep Out + min 120ms */
			05 01 00 00 80 00 01 11
			/*GIP Setting - APO high*/
			39 01 00 00 64 00 1B E5 0B 0A 1C 00 02 04 06 08 0F 1B 02 1A 1A 0B 0A 1C 01 03 05 07 09 10 1B 03 1A 1A
			/*Power Sequence Option Configuration*/
			39 01 00 00 00 00 06 C9 05 5D 03 04 00
			/*GIP Setting*/
			39 01 00 00 00 00 1B E5 0B 0A 0C 00 02 04 06 08 0F 1B 02 1A 1A 0B 0A 0C 01 03 05 07 09 10 1B 03 1A 1A
			/*Black Frame Setting*/
			39 01 00 00 00 00 03 BD 01 05
			05 01 00 00 05 00 01 29
		];
		lge,mdss-dsi-extra-command-state-on-with-apo = "dsi_lp_mode";

		lge,blmap-list =
			"lge,blmap",
			"lge,blmap-psm",
			"lge,blmap-gal",
			"lge,blmap-hqc",
			"lge,blmap-hl",
			"lge,blmap-psm-hl",
			"lge,blmap-gal-hl",
			"lge,blmap-hqc-hl",
			"lge,blmap-max",
			"lge,blmap-max-hl",
			"lge,blmap-hbm-hd",
			"lge,blmap-ex";

		lge,blmap-for-mplus-mode =
			"lge,blmap",		/* LGE_MP_NOR */
			"lge,blmap-psm",	/* LGE_MP_PSM */
			"lge,blmap-hbm-hd",	/* LGE_MP_HBM */
			"lge,blmap-gal",	/* LGE_MP_GAL */
			"lge,blmap",		/* LGE_MP_BRI not used */
			"lge,blmap-psm",	/* LGE_MP_PS2 not used */
			"lge,blmap-hqc",	/* LGE_MP_HQC */
			"lge,blmap-max";	/* LGE_MP_FHB */

		lge,blmap = <
			0	17	17	17	17	17	17	17	17	17		/* 0 ~ 9 */
			17	17	17	18	18	18	19	19	20	20		/* 10 ~ 19 */
			20	21	21	22	22	23	24	25	26	27		/* 20 ~ 29 */
			27	28	29	30	31	32	33	34	36	37		/* 30 ~ 39 */
			38	40	41	42	44	45	46	48	49	51		/* 40 ~ 49 */
			54	57	60	63	66	69	72	75	78	82		/* 50 ~ 59 */
			84	87	90	93	95	98	101	104	107	109		/* 60 ~ 69 */
			112	115	118	121	126	131	136	141	146	151		/* 70 ~ 79 */
			156	161	166	171	176	182	186	191	196	201		/* 80 ~ 89 */
			206	211	215	220	225	230	235	240	245	252		/* 90 ~ 99 */
			260	268	276	284	291	299	307	315	323	331		/* 100 ~ 109 */
			338	346	354	362	369	377	385	393	400	408		/* 110 ~ 119 */
			416	424	432	438	445	451	458	464	471	478		/* 120 ~ 129 */
			484	491	497	504	511	521	531	541	551	561		/* 130 ~ 139 */
			572	582	592	602	612	623	632	641	650	659		/* 140 ~ 149 */
			669	678	687	696	706	715	724	733	743	753		/* 150 ~ 159 */
			764	774	785	795	806	817	827	838	848	859		/* 160 ~ 169 */
			870	883	896	909	923	936	949	963	976	989		/* 170 ~ 179 */
			1003	1016	1029	1043	1056	1070	1084	1098	1111	1125		/* 180 ~ 189 */
			1139	1153	1166	1180	1194	1208	1221	1235	1248	1262		/* 190 ~ 199 */
			1276	1289	1303	1316	1330	1344	1357	1371	1385	1403		/* 200 ~ 209 */
			1421	1440	1458	1476	1495	1513	1531	1550	1568	1587		/* 210 ~ 219 */
			1604	1622	1640	1658	1676	1694	1711	1729	1747	1765		/* 220 ~ 229 */
			1783	1801	1819	1837	1855	1873	1891	1909	1927	1945		/* 230 ~ 239 */
			1963	1981	1999	2017	2036	2061	2086	2111	2137	2162		/* 240 ~ 249 */
			2187	2212	2238	2263	2288	2314						/* 250 ~ 255 */
		>;

		lge,blmap-psm = <
			0	16	16	16	16	16	16	16	16	16		/* 0 ~ 9 */
			16	16	16	16	16	16	16	16	16	16		/* 10 ~ 19 */
			16	16	16	17	17	18	19	19	20	21		/* 20 ~ 29 */
			21	22	23	23	24	25	26	27	28	29		/* 30 ~ 39 */
			30	31	32	33	34	35	36	37	38	40		/* 40 ~ 49 */
			42	44	46	49	51	53	56	58	60	63		/* 50 ~ 59 */
			65	67	70	72	74	77	79	81	84	86		/* 60 ~ 69 */
			88	91	93	96	99	103	107	111	114	118		/* 70 ~ 79 */
			122	126	129	133	137	141	145	149	153	157		/* 80 ~ 89 */
			161	165	170	174	178	182	186	190	195	201		/* 90 ~ 99 */
			207	213	219	225	231	237	243	249	255	262		/* 100 ~ 109 */
			269	276	283	290	297	304	311	318	325	332		/* 110 ~ 119 */
			339	346	353	358	363	368	374	379	384	389		/* 120 ~ 129 */
			395	400	405	410	416	423	430	437	444	451		/* 130 ~ 139 */
			459	466	473	480	487	495	502	510	518	526		/* 140 ~ 149 */
			534	542	549	557	565	573	581	589	597	606		/* 150 ~ 159 */
			616	625	635	644	654	664	673	683	692	702		/* 160 ~ 169 */
			712	720	728	736	745	753	761	770	778	786		/* 170 ~ 179 */
			795	803	811	820	831	842	853	864	875	886		/* 180 ~ 189 */
			897	908	919	930	941	952	962	973	984	995		/* 190 ~ 199 */
			1006	1017	1027	1038	1049	1060	1071	1082	1093	1106		/* 200 ~ 209 */
			1120	1133	1147	1161	1174	1188	1202	1215	1229	1243		/* 210 ~ 219 */
			1257	1271	1285	1299	1313	1327	1341	1355	1369	1383		/* 220 ~ 229 */
			1397	1411	1425	1439	1454	1468	1483	1497	1512	1527		/* 230 ~ 239 */
			1541	1556	1570	1585	1600	1615	1631	1647	1663	1679		/* 240 ~ 249 */
			1695	1711	1727	1743	1759	1775						/* 250 ~ 255 */
		>;

		lge,blmap-gal = <
			0	10	10	10	10	10	10	10	10	10		/* 0 ~ 9 */
			10	10	11	11	12	13	13	14	14	15		/* 10 ~ 19 */
			16	16	17	18	19	20	21	22	23	24		/* 20 ~ 29 */
			25	26	27	28	29	30	31	33	35	36		/* 30 ~ 39 */
			38	40	42	43	45	47	48	50	52	54		/* 40 ~ 49 */
			57	61	64	68	71	75	78	82	85	89		/* 50 ~ 59 */
			92	96	99	103	106	110	113	117	120	124		/* 60 ~ 69 */
			127	131	134	138	143	148	153	158	163	168		/* 70 ~ 79 */
			173	178	183	188	193	198	203	209	215	221		/* 80 ~ 89 */
			226	232	238	244	249	255	261	267	273	282		/* 90 ~ 99 */
			292	302	312	322	331	341	351	361	371	381		/* 100 ~ 109 */
			387	393	399	405	411	417	423	429	435	441		/* 110 ~ 119 */
			447	453	459	468	477	486	495	504	513	522		/* 120 ~ 129 */
			531	540	549	558	568	579	590	601	612	623		/* 130 ~ 139 */
			634	645	656	667	678	690	700	711	722	733		/* 140 ~ 149 */
			743	754	765	776	786	797	808	819	830	842		/* 150 ~ 159 */
			855	868	881	894	907	919	932	945	958	971		/* 160 ~ 169 */
			984	997	1010	1023	1037	1050	1063	1077	1090	1103		/* 170 ~ 179 */
			1117	1130	1143	1157	1172	1187	1203	1218	1234	1249		/* 180 ~ 189 */
			1264	1280	1295	1311	1326	1342	1357	1373	1389	1404		/* 190 ~ 199 */
			1420	1436	1451	1467	1483	1498	1514	1530	1546	1566		/* 200 ~ 209 */
			1586	1607	1627	1648	1668	1689	1709	1730	1750	1771		/* 210 ~ 219 */
			1789	1807	1825	1844	1862	1880	1899	1917	1935	1954		/* 220 ~ 229 */
			1972	1990	2009	2030	2051	2073	2094	2116	2137	2158		/* 230 ~ 239 */
			2180	2201	2223	2244	2266	2291	2317	2343	2369	2395		/* 240 ~ 249 */
			2420	2446	2472	2498	2524	2550						/* 250 ~ 255 */
		>;

		lge,blmap-hqc = <
			0
			16 16 16 16 16 16 16 16 16 16 16 16 17 17 17 17 18 18 18 18
			19 19 19 20 21 22 23 24 26 27 28 29 30 31 32 34 36 37 39 41
			43 44 46 48 50 51 53 55 58 61 64 67 70 73 75 78 81 84 87 90
			94 98 102 106 110 114 118 122 126 130 134 138 143 148 152 157 162 167 171
			176 181 186 190 195 201 207 212 218 224 230 235 241 247 253 258 264 270 277 284
			291 298 305 313 320 327 334 341 348 355 363 371 380 388 396 404 412 420 429 437
			445 453 462 472 481 490 500 509 518 528 537 546 556 565 575 584 594 603 613 623
			632 642 652 661 671 680 690 702 714 726 738 750 762 773 785 797 809 821 833 846
			859 872 885 898 912 925 938 951 964 977 990 1005 1020 1035 1050 1065 1080 1095 1110 1125
			1140 1155 1170 1185 1199 1214 1228 1243 1258 1272 1287 1302 1316 1331 1345 1360 1378 1396 1414 1432
			1450 1468 1486 1504 1522 1540 1558 1576 1595 1615 1634 1653 1673 1692 1711 1731 1750 1769 1789 1808
			1829 1850 1871 1892 1913 1934 1955 1976 1997 2018 2039 2060 2081 2103 2124 2146 2167 2188 2210 2231
			2252 2274 2295 2317 2338 2365 2391 2418 2444 2471 2497 2524 2550 2577 2603 2630
		>;

		lge,blmap-max = <
			0
			2630 2635 2640 2645 2650 2654 2659 2664 2669 2674 2679 2684 2689 2693 2698 2703 2708 2713 2718 2723
			2728 2733 2737 2742 2747 2752 2757 2762 2767 2772 2776 2781 2786 2791 2796 2801 2806 2811 2816 2820
			2825 2830 2835 2840 2845 2850 2855 2859 2864 2869 2874 2879 2884 2889 2894 2899 2903 2908 2913 2918
			2923 2928 2933 2938 2942 2947 2952 2957 2962 2967 2972 2977 2981 2986 2991 2996 3001 3006 3011 3016
			3021 3025 3030 3035 3040 3045 3050 3055 3060 3064 3069 3074 3079 3084 3089 3094 3099 3104 3108 3113
			3118 3123 3128 3133 3138 3143 3147 3152 3157 3162 3167 3172 3177 3182 3187 3191 3196 3201 3206 3211
			3216 3221 3226 3230 3235 3240 3245 3250 3255 3260 3265 3270 3274 3279 3284 3289 3294 3299 3304 3309
			3313 3318 3323 3328 3333 3338 3343 3348 3353 3357 3362 3367 3372 3377 3382 3387 3392 3396 3401 3406
			3411 3416 3421 3426 3431 3436 3440 3445 3450 3455 3460 3465 3470 3475 3479 3484 3489 3494 3499 3504
			3509 3514 3519 3523 3528 3533 3538 3543 3548 3553 3558 3562 3567 3572 3577 3582 3587 3592 3597 3601
			3606 3611 3616 3621 3626 3631 3636 3641 3645 3650 3655 3660 3665 3670 3675 3680 3684 3689 3694 3699
			3704 3709 3714 3719 3724 3728 3733 3738 3743 3748 3753 3758 3763 3767 3772 3777 3782 3787 3792 3797
			3802 3807 3811 3816 3821 3826 3831 3836 3841 3846 3850 3855 3860 3865 3870
		>;

		lge,blmap-hl = <
			0
			2314 2349 2384 2419 2454 2490 2525 2560 2595 2630
		>;

		lge,blmap-psm-hl = <
			0
			1775 1778 1781 1785 1788 1791 1795 1798 1801 1805
			1808 1812 1815 1818 1822 1825 1828 1832 1835 1838
			1842 1845 1849 1852 1855 1859 1862 1865 1869 1872
			1875 1879 1882 1886 1889 1892 1896 1899 1902 1906
			1909 1913 1916 1919 1923 1926 1929 1933 1936 1939
			1943 1946 1950 1953 1956 1960 1963 1966 1970 1973
			1976 1980 1983 1987 1990 1993 1997 2000 2003 2007
			2010 2013 2017 2020 2024 2027 2030 2034 2037 2040
			2044 2047 2051 2054 2057 2061 2064 2067 2071 2074
			2077 2081 2084 2088 2091 2094 2098 2101 2104 2108
			2111 2114 2118 2121 2125 2128 2131 2135 2138 2141
			2145 2148 2152 2155 2158 2162 2165 2168 2172 2175
			2178 2182 2185 2189 2192 2195 2199 2202 2205 2209
			2212 2215 2219 2222 2226 2229 2232 2236 2239 2242
			2246 2249 2252 2256 2259 2263 2266 2269 2273 2276
			2279 2283 2286 2290 2293 2296 2300 2303 2306 2310
			2313 2316 2320 2323 2327 2330 2333 2337 2340 2343
			2347 2350 2353 2357 2360 2364 2367 2370 2374 2377
			2380 2384 2387 2391 2394 2397 2401 2404 2407 2411
			2414 2417 2421 2424 2428 2431 2434 2438 2441 2444
			2448 2451 2454 2458 2461 2465 2468 2471 2475 2478
			2481 2485 2488 2491 2495 2498 2502 2505 2508 2512
			2515 2518 2522 2525 2529 2532 2535 2539 2542 2545
			2549 2552 2555 2559 2562 2566 2569 2572 2576 2579
			2582 2586 2589 2592 2596 2599 2603 2606 2609 2613
			2616 2619 2623 2626 2630
		>;

		lge,blmap-gal-hl = <
			0
			2550 2559 2568 2577 2586 2594 2603 2612 2621 2630

		>;

		lge,blmap-hqc-hl = <
			0
			2630 2630 2630 2630 2630 2630 2630 2630 2630 2630
		>;

		lge,blmap-max-hl = <
			0
			3870 3870 3870 3870 3870 3870 3870 3870 3870 3870
		>;

		lge,blmap-hbm-hd = <
			0
			16 26 37 47 57 67 78 88 98 109 119 129 139 150 160 170 181 191 201 212
			222 232 242 253 263 273 284 294 304 314 325 335 345 356 366 376 386 397 407 417
			428 438 448 459 469 479 489 500 510 520 531 541 551 561 572 582 592 603 613 623
			633 644 654 664 675 685 695 706 716 726 736 747 757 767 778 788 798 808 819 829
			839 850 860 870 880 891 901 911 922 932 942 953 963 973 983 994 1004 1014 1025 1035
			1045 1055 1066 1076 1086 1097 1107 1117 1127 1138 1148 1158 1169 1179 1189 1200 1210 1220 1230 1241
			1251 1261 1272 1282 1292 1302 1313 1323 1333 1344 1354 1364 1374 1385 1395 1405 1416 1426 1436 1446
			1457 1467 1477 1488 1498 1508 1519 1529 1539 1549 1560 1570 1580 1591 1601 1611 1621 1632 1642 1652
			1663 1673 1683 1693 1704 1714 1724 1735 1745 1755 1766 1776 1786 1796 1807 1817 1827 1838 1848 1858
			1868 1879 1889 1899 1910 1920 1930 1940 1951 1961 1971 1982 1992 2002 2013 2023 2033 2043 2054 2064
			2074 2085 2095 2105 2115 2126 2136 2146 2157 2167 2177 2187 2198 2208 2218 2229 2239 2249 2260 2270
			2280 2290 2301 2311 2321 2332 2342 2352 2362 2373 2383 2393 2404 2414 2424 2434 2445 2455 2465 2476
			2486 2496 2507 2517 2527 2537 2548 2558 2568 2579 2589 2599 2609 2620 2630
		>;

		lge,blmap-ex = <
			0
			16 16 16 16 16 16 16 16 16 18 20 22 25 27 29 31 33 35 37 40
			42 44 46 48 50 53 55 57 59 61 63 65 68 70 72 74 81 87 94 100
			107 113 120 127 133 140 146 153 159 166 172 179 186 192 199 205 212 218 225 232
			238 245 251 258 264 271 277 284 291 297 304 310 317 323 330 342 354 366 378 390
			402 414 426 438 450 462 474 486 498 510 522 534 546 558 570 582 594 594 594 594
			594 594 594 594 594 594 594 594 594 594 594 594 594 594 594 615 637 658 679 701
			722 744 765 786 808 829 850 872 893 915 936 957 979 1000 1039 1078 1117 1156 1195 1234
			1248 1262 1276 1290 1304 1318 1332 1346 1360 1374 1388 1402 1416 1430 1444 1458 1472 1486 1500
		>;

		qcom,mdss-pan-physical-width-dimension = <65>;
		qcom,mdss-pan-physical-height-dimension = <140>;


		qcom,mdss-dsi-on-command = [
			/* TE On */
			15 01 00 00 00 00 02 35 00
			/* Page Address Set */
			39 01 00 00 00 00 05 2B 00 00 0C 2F
			/* BLU Control */
			15 01 00 00 00 00 02 51 FF
			15 01 00 00 00 00 02 53 2C
			15 01 00 00 00 00 02 5E 00
			15 01 00 00 00 00 02 55 81
			/*Manufacturer protection*/
			15 01 00 00 00 00 02 B0 AC
			/*Source Control*/
			39 01 00 00 00 00 09 B3 04 04 28 08 5A 12 23 02
			/*Gate & Mux Control*/
			39 01 00 00 00 00 20 B4 11 04 02 02 02 02 02 01 01 01 01 01 01 D0 E4 E4 E4 93 4E 39 0A 10 18 25 24 00 00 00 00 00 00
			/*Sync Setup*/
			39 01 00 00 00 00 09 B5 2E 0F 10 C0 00 10 C0 00
			/*Panel Setting*/
			39 01 00 00 00 00 06 B6 03 05 0B B3 30
			/*Touch Timing Control*/
			39 01 00 00 00 00 20 B8 57 02 90 40 5D D0 05 00 00 18 22 04 01 02 90 40 4C C0 04 00 00 18 22 04 01 08 00 3A 86 83 00
			/*Touch Source Setting*/
			39 01 00 00 00 00 06 B9 64 64 2A 3F EE
			/*DSC Configuration*/
			39 01 00 00 00 00 0C BA 3D 1F 01 FF 01 3C 1F 01 FF 01 00
			/*Low Rate Refresh Setting*/
			39 01 00 00 00 00 05 BC 00 00 00 10
			/*Black Frame Setting*/
			39 01 00 00 00 00 03 BD 00 00
			/* U2 Corner Down */
			39 01 00 00 00 00 03 BF 4F 02
			/*Internal Oscillator Setting*/
			39 01 00 00 00 00 0B C0 00 04 18 07 11 11 3C 00 0A 0A
			/*Power Control1*/
			39 01 00 00 00 00 07 C1 01 00 F0 C2 CF 0C
			/*Power Control2*/
			39 01 00 00 00 00 09 C2 CC 44 44 20 22 26 21 00
			/*Power Control3*/
			39 01 00 00 00 00 13 C3 92 11 09 09 11 CC 02 02 A4 A4 02 A2 38 28 14 40 38 C0
			/*Vcom Setting*/
			39 01 00 00 00 00 03 C4 26 00
			/*Power Sequence Option Configuration*/
			39 01 00 00 00 00 06 C9 05 5D 03 04 00
			/*Abrupt Power Off Control*/
			39 01 00 00 00 00 03 CA 9B 10
			/*LFD Control*/
			39 01 00 00 00 00 06 CB F3 90 3D 30 CC
			/*Tail TFT Setting*/
			39 01 00 00 00 00 06 CC 00 40 50 90 41
			/*U2 Option*/
			39 01 00 00 00 00 03 CE 00 00
			/*Gamma*/
			39 01 00 00 00 00 A9 D0 12 05 20 1B 2C 28 3F 3F 50 50 68 68 71 71 79 79 82 82 8A 8A 99 99 3F 3F 9F 9F 91 91 89 89 81 81 76 76 64 64 46 46 2d 2d 00 01 12 05 20 1B 2C 28 3F 3F 50 50 68 68 71 71 79 79 82 82 8A 8A 99 99 3F 3F 9F 9F 91 91 89 89 81 81 76 76 64 64 46 46 2d 2d 00 01 12 05 20 1B 2C 28 3F 3F 50 50 68 68 71 71 79 79 82 82 8A 8A 99 99 3F 3F 9F 9F 91 91 89 89 81 81 76 76 64 64 46 46 2d 2d 00 01 12 05 20 1B 2C 28 3F 3F 50 50 68 68 71 71 79 79 82 82 8A 8A 99 99 3F 3F 9F 9F 91 91 89 89 81 81 76 76 64 64 46 46 2d 2d 00 01
			39 01 00 00 00 00 A9 D1 12 05 20 1B 2C 28 3F 3D 4F 4F 66 66 6E 6E 76 76 80 80 88 88 95 95 3F 3F A2 A2 94 94 8B 8B 81 81 75 75 66 66 47 47 2D 2D 00 01 12 05 20 1B 2C 28 3F 3D 4f 4f 66 66 6e 6e 76 76 80 80 88 88 95 95 3F 3F A2 A2 94 94 8b 8b 81 81 75 75 66 66 47 47 2d 2d 00 01 12 05 20 1B 2C 28 3F 3D 4f 4f 66 66 6e 6e 76 76 80 80 88 88 95 95 3F 3F A2 A2 94 94 8b 8b 81 81 75 75 66 66 47 47 2d 2d 00 01 12 05 20 1B 2C 28 3F 3D 4f 4f 66 66 6e 6e 76 76 80 80 88 88 94 94 3F 3F A4 A4 95 95 8b 8b 81 81 75 75 66 66 47 47 2d 2d 00 01
			39 01 00 00 00 00 A9 D2 12 05 20 1B 2C 28 3F 3D 4F 4F 66 66 6E 6E 76 76 80 80 88 88 95 95 3F 3F A2 A2 94 94 8B 8B 81 81 75 75 66 66 47 47 2D 2D 00 01 12 05 20 1B 2C 28 3F 3D 4f 4f 66 66 6e 6e 76 76 80 80 88 88 95 95 3F 3F A2 A2 94 94 8b 8b 81 81 75 75 66 66 47 47 2d 2d 00 01 12 05 20 1B 2C 28 3F 3D 4f 4f 66 66 6e 6e 76 76 80 80 88 88 95 95 3F 3F A2 A2 94 94 8b 8b 81 81 75 75 66 66 47 47 2d 2d 00 01 12 05 20 1B 2C 28 3F 3D 4f 4f 66 66 6e 6e 76 76 80 80 88 88 94 94 3F 3F A4 A4 95 95 8b 8b 81 81 75 75 66 66 47 47 2d 2d 00 01
			/* MPLUS Control */
			39 01 00 00 00 00 05 D3 12 01 00 00
			/*Mplus Setting*/
			39 01 00 00 00 00 96 D4 DC 5F 9C BE 39 39 39 47 48 48 48 3A 00 03 6D 80 00 00 8C 66 00 00 8C 66 00 00 8C 66 00 0A 48 80 00 0A 48 80 00 0A 48 80 00 0A 48 80 20 0A 14 0A 18 00 1C CC 23 9E 23 9E 01 01 01 01 04 04 04 04 01 00 02 80 00 10 00 10 00 10 13 9E 13 9E 13 9E 13 9E 05 05 05 05 05 05 05 05 23 9E FF FF 13 33 18 00 16 66 10 00 FF 01 00 02 00 03 00 04 00 05 00 06 00 07 00 08 00 09 00 0A 00 0B 00 0C 00 0D 00 0E 00 0F 00 1B 25 DC 18 00 20 00 1C E1 00 FF E0 C8 C8 41 8F
			/*Notch Up Gradation*/
			39 01 00 00 00 00 21 AD 01 02 03 04 05 06 06 06 06 06 06 06 06 06 06 06 20 40 60 90 C0 F0 FF FF FF FF FF FF FF FF FF FF
			/*Notch Down Gradation*/
			39 01 00 00 00 00 21 AE 01 02 03 04 05 06 06 06 06 06 06 06 06 06 06 06 20 40 60 90 C0 F0 FF FF FF FF FF FF FF FF FF FF
			/*GIP Setting*/
			39 01 00 00 00 00 1B E5 0B 0A 0C 00 02 04 06 08 0F 1B 02 1A 1A 0B 0A 0C 01 03 05 07 09 10 1B 03 1A 1A
			/*Mux Setting*/
			39 01 00 00 00 00 11 E6 11 12 13 14 15 16 17 18 11 12 13 14 15 16 17 18
			/*Test1*/
			39 01 00 00 00 00 07 ED 21 49 00 00 00 00
			/*BLU Control*/
			15 01 00 00 00 00 02 55 81
			/*Sharpness*/
			39 01 00 00 00 00 06 F3 00 01 00 0D 00
			39 01 00 00 00 00 0E F4 00 00 40 83 C5 00 01 00 00 00 00 00 00
			39 01 00 00 00 00 18 FB 20 40 60 80 A0 C0 E0 1A 29 2C 2C 2B 20 22 00 9A A9 B9 C8 D8 E7 F4 FF
			/*Gamma Correction*/
			39 01 00 00 00 00 02 F5 00
			39 01 00 00 00 00 11 F6 40 40 40 40 40 40 40 40 00 00 00 00 00 00 00 00
			39 01 00 00 00 00 11 F7 40 40 40 40 40 40 40 40 00 00 00 00 00 00 00 00
			39 01 00 00 00 00 11 F8 40 40 40 40 40 40 40 40 00 00 00 00 00 00 00 00
			/*BLU PWM Control*/
			39 01 00 00 00 00 0E FC 13 70 D0 26 30 7C 02 FF 12 22 22 10 00
			/* Normal Display mode on */
			05 01 00 00 00 00 01 13
			/* Sleep Out + min 120ms */
			05 01 00 00 80 00 01 11
			/*Black Frame Setting*/
			39 01 00 00 00 00 03 BD 01 05
			05 01 00 00 05 00 01 29
		];
		qcom,mdss-dsi-on-command-state = "dsi_lp_mode";
		qcom,mdss-dsi-off-command = [
			/* Display Off */
			05 01 00 00 00 00 01 28
			/* Sleep In + min 120ms */
			05 01 00 00 80 00 01 10
		];
		qcom,mdss-dsi-off-command-state = "dsi_hs_mode";

		qcom,compression-mode = "dsc";
		qcom,config-select = <&dsi_sw49410_dsc_cmd_config0>;

		qcom,mdss-dsc-version = <0x11>;
		qcom,mdss-dsc-scr-version = <0x1>;

		dsi_sw49410_dsc_cmd_config0: config0 {
			qcom,lm-split = <720 720>;
			qcom,mdss-dsc-encoders = <2>;
			qcom,mdss-dsc-slice-height = <60>;
			qcom,mdss-dsc-slice-width = <720>;
			qcom,mdss-dsc-slice-per-pkt = <2>;
			qcom,mdss-dsc-bit-per-component = <8>;
			qcom,mdss-dsc-bit-per-pixel = <8>;
			qcom,mdss-dsc-block-prediction-enable;
		};
	};
};
