
qcom,LGE_BLT39_Tocad_3000mAh {
	/* #3354263_LGE_BLT39tocad_3000mAh_averaged_MasterSlave_Mar12th2018*/
	qcom,max-voltage-uv = <4400000>;
	qcom,nom-batt-capacity-mah = <3000>;
	qcom,batt-id-kohm = <45>;
	qcom,battery-beta = <4150>;
	qcom,fg-cc-cv-threshold-mv = <4390>;
	qcom,battery-type = "LGE_BLT39_Tocad_3000mAh";
	qcom,chg-rslow-comp-c1 = <3170584>;
	qcom,chg-rslow-comp-c2 = <3759143>;
	qcom,chg-rs-to-rslow = <1270702>;
	qcom,chg-rslow-comp-thr = <0x99>;
	qcom,checksum = <0x7DB3>;
	qcom,gui-version = "PMI8996GUI - 1.1.0.4";
	qcom,fg-profile-data = [
		 FD 83 73 7D 
		 46 81 1E 77 
		 3C 83 89 72 
		 4E 7E 4B 7B 
		 FB 81 4C 9B 
		 B2 BE 31 D0 
		 84 11 E4 83 
		 6F 7C B2 80 
		 6D 76 25 83 
		 51 7B 5D 8D 
		 F3 89 16 82 
		 75 A0 AD C5 
		 04 D9 61 0C 
		 AB 0B 34 5B 
		 14 70 71 FD 
		 BD 32 D3 46 
		 FE 24 00 00 
		 E9 4C 91 3B 
		 DE 3B 00 00 
		 00 00 00 00 
		 00 00 00 00 
		 66 71 79 6B 
		 85 8D 97 75 
		 2C 7C 67 70 
		 6C 74 4D 78 
		 95 75 81 68 
		 E8 5D 97 A8 
		 23 DD 62 15 
		 65 A0 71 0C 
		 28 00 FF 36 
		 F0 11 30 03 
		 00 00 00 0C 
	];
};
