## arch/arm64/configs/falcon_kr-debug_defconfig
```kconfig
include falcon_kr_common
include falcon_common-debug
CONFIG_MEM_SHARE_QMI_SERVICE=y
```

## arch/arm64/configs/falcon_lao_com-debug_defconfig
```kconfig
include falcon_lao_com_common
include falcon_common-debug
CONFIG_MEM_SHARE_QMI_SERVICE=y
```

## arch/arm64/configs/lucye_vzw-debug_defconfig
```kconfig
include lucye_vzw_common
include lucye_common-debug
CONFIG_MEM_SHARE_QMI_SERVICE=y
CONFIG_VPNCLIENT_SECURITY=m
CONFIG_LG_VPN_V37=y
```

## drivers/block/zram/Kconfig
```kconfig
config ZRAM
	tristate "Compressed RAM block device support"
	depends on BLOCK && SYSFS && ZSMALLOC && CRYPTO
	select CRYPTO_LZO
	default n
	help
	  Creates virtual block devices called /dev/zramX (X = 0, 1, ...).
	  Pages written to these disks are compressed and stored in memory
	  itself. These disks allow very fast I/O and compression provides
	  good amounts of memory savings.

	  It has several use cases, for example: /tmp storage, use as swap
	  disks and maybe many more.

	  See zram.txt for more information.

config ZRAM_NON_SWAP
	bool "Enable zram non_swap support"
	depends on ZRAM
	select NON_SWAP
	default n
	help
	  This option add a interface "non_swap" to zram. User can set
	  a unsigned int value to zram.
	  If a page that compressed size is bigger than limit. mark it ad
	  non-swap. Then this page will add to unevictable lru list.
```

## drivers/input/fingerprint/Kconfig
```kconfig
#
# Fingerprints driver configuration
#
menuconfig INPUT_FINGERPRINT
	bool "FingerPrints"
	help
	  Say Y here, and a list of supported fingerprints will be displayed.
	  This option doesn't affect the kernel.

	  If unsure, say Y.

if INPUT_FINGERPRINT
config INPUT_IX_BTP
       tristate "IX fingerprint sensor support"
       depends on SPI_MASTER
config INPUT_FINGERPRINT_FPC_BTP
	tristate "FPC1022 fingerprint sensor support by CrucialSoft"
	depends on SPI_MASTER
	help
	 Say Y here if you want to support FPC1022
	 connected via an SPI bus.

	 To compile this driver as a module, choose M here: the module
	 will be called FPC1022.

config INPUT_FINGERPRINT_FPC1020
	tristate "FPC1022 fingerprint sensor support by FPC"
	depends on SPI_MASTER
	help
	 Say Y here if you want to support FPC1022
	 connected via an SPI bus.

	 To compile this driver as a module, choose M here: the module
	 will be called FPC1022.

endif

config FINGERPRINT_GOODIX_GF3208
        tristate "Goodix GF3208 fingerprint drvier support"
	help
          Say Y here to enable goodix fingerprint driver support
```

## zefie/Kconfig
```kconfig
menu "Melina-specific Configuration"

config MELINA_CPU_OPTIMIZE
        bool "Compiler CPU Optimizations"
	default y
	help
	  Enables CPU optimizations flags, depending on your compiler, if any, you wish to compile
	  the kernel with. Please note that some options are incompatible
	  with the clang compiler.

	  If unsure, select Y.

config MELINA_DRIVEDROID_CDROM
        boolean "DriveDroid CD-ROM Mass Storage Emulation"
        depends on !LGE_USB_G_AUTORUN
        depends on USB_G_ANDROID
        default y
        help
          Allows you to mount CD-ROM ISO images with DriveDroid.
          Without this, the image will try to mount as a USB Disk (flash drive).

config MELINA_BCMDHD_MONITOR_MODE
        boolean "WiFi Monitor Mode Support"
        depends on BCMDHD
        default y
        help
          Enables monitor mode in the BCM WiFi Drivers

	  If unsure, say Y.

config MELINA_PERFORMANCE_TWEAKS
	boolean "Enable Melina Kernel Performance Tweaks"
	select CPU_INPUT_BOOST
	select TCP_CONG_WESTWOOD
	default y
	help
	  This is just a helper variable that enables the following:
	  CPU_INPUT_BOOST and TCP_CONG_WESTWOOD


config MELINA_WARN_AS_ERR
	bool "Treat compile warnings as errors (-Werror)"
        default y
	help
	  Disabling this option will allow the kernel to compile with warnings, but is not advised.

	  If unsure, say y here.

menu "Melina-specific Kernel Debugging Options"

config MELINA_DEBUG_ENABLE
	bool "Enable Full Standard LGE Kernel Debug Info"
	depends on !MELINA_DEBUG_DISABLE
	default y
	select EMBEDDED
	select EXPERT
	select GENERIC_TRACER
	select EVENT_TRACING
	select DEBUG
	select DEBUG_INFO
	select DEBUG_KERNEL
	select MSM_RTB
	select INPUT_EVBUG
	help
	  Select this to have a fully verbose kernel, like LGE's stock.
	  Selecting this turns on full kernel debug support, and may trigger a NOTICE when booting Android.
	  Select "Enhanced Debug Removal" to disable debug support, and remove the warning, but at the cost
	  of making it more difficult to debug.

	  This option may cause a NOTICE in the kernel log during Android boot regarding 
          a DEBUG kernel and "trace_printk". The warning is harmless, but this may slightly
	  reduce performance.  However, it will make it easier to diagnose any problems.

	  If unsure, say Y here while developing, then say N here when making a public release.

menuconfig MELINA_DEBUG_DISABLE
	bool "Enable Melina Kernel Optimized Debug Removal"
        default n
	help
	  These options significantly reduce the amount of debug information processed and displayed by
	  the Qualcomm, Broadcom and LGE drivers, slightly improving performance.

	  Under this menu, you can enable and disable specific device driver debug.

	  This option is required to remove the "trace_printk" warning on Android boot.
	  This may slightly increase performance, but will make it harder to diagnose any problems.

	  If unsure, say N here while developing, then say Y here when making a public release.

if MELINA_DEBUG_DISABLE

config MELINA_QUIET_DHD
        bool "Silence DHD Wifi/BT Debug Info"
        default y
        depends on BCMDHD || BCMDHD_EXT
        help
          Silences information from the DHD Wifi/BT driver, which is only useful for debugging.

config MELINA_QUIET_MSMVIDEO
        bool "Silence MSM Video Debug Info"
        default y
        depends on PCI_MSM
        help
          Silences information from the graphics driver, which is only useful for debugging.

config MELINA_QUIET_MSMPCI
        bool "Silence MSM PCI Bus Debug Info"
        default y
        depends on FB_MSM_MDSS || FB_MSM_MDP
        help
          Silences information from the MSM PCI Bus driver, which is only useful for debugging.

config MELINA_QUIET_POWER
        bool "Silence Power (SMB138x Charger & LGE Battery) Debug Info"
        default y
        depends on QPNP_SMBCHARGER
        help
          Silences information from the charging driver curcuit, which is only useful for debugging.

config MELINA_QUIET_TOUCH
        bool "Silence Touchscreen (sw49048) Debug Info"
        default y
        depends on QPNP_SMBCHARGER
        help
          Silences information from the touchscreen driver, which is only useful for debugging.

config MELINA_QUIET_FM
        bool "Silence FM Radio (si470x) RDS and Tuning Debug Info"
        default y
        depends on RADIO_SI470X
        help
          Silences information from the touchscreen driver, which is only useful for debugging.


endif # MELINA_DEBUG_DISABLE

endmenu # debug


endmenu # main
```
